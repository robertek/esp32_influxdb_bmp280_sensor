## main/Kconfig.projbuild
```kconfig
menu "Configuration"

	config WIFI_SSID
		string "WiFi SSID"
		default "myssid"

	config WIFI_PASSWORD
		string "WiFi Password"
		default "mypass"

	config MAXIMUM_RETRY
		int "Maximum WIFI connection retry"
		default 5

	config INFLUX_IP
		string "Influxdb IP address"
		default "192.168.1.1"

	config INFLUX_PORT
		string "Influxdb port number"
		default "8086"

	config INFLUX_DB
		string "Influxdb database name"
		default "test"

	config INFLUX_MEAS
		string "Influxdb measurement name"
		default "baro"

	config INFLUX_SITE
		string "Measurement site tag"
		default "mysite"

	config INFLUX_PLACE
		string "Measurement place tag"
		default "myplace"

	config SAFE_TIMER
		int "Safe timer (sec)"
		default 3600
		help
			Set safe timer to wake up in any case. (sec)

	config TDIFF
		int "Temperature difference to wake up from ULP"
		default 40
		help
			Temperature difference to wake up main CPU. It is
			difference of raw values BMP280 provide.
			40 is somewhere around 0.1C.

	config HDIFF
		int "Pressure difference to wake up from ULP"
		default 256
		help
			Humidity difference to wake up main CPU. It is
			difference of raw values SH4x provides.
			Humidity may be more variable, so the default is
			256, which is around 0.5%.

	config PERIOD
		int "Period the ULP makes the measurement (s)"
		default 5
		help
			It is the number of the ULP wakeup cycles it makes
			a measurement. The ULP wakes up every 1s.
	config LED_GPIO
		int "LED GPIO"
		default 13
		help
			Set a GPIO number for the notification LED. (optional)
	config BATT_EN
		int "Battery measurement enable GPIO"
		default 16
		help
			Set a GPIO number for enabling battery measurement. (optional)
	config BATT_CHANNEL
		int "Battery ADC2 channel"
		default 0
		help
			Set the ADC channel for the battery. (optional)
	config BATT_COEF
		int "Battery voltage multiply coefficient"
		default 11
		help
			Multiply coefficient based on voltage divider. (optional)
	config BATT_OFFSET
		int "Battery voltage offset"
		default 0
		help
			Offset the final voltage (calibration). (optional)
	config BATT_WAIT
		int "Wait for the battery measurement to settle (ms)"
		default 100
		help
			Wait for the battery to settle (load capacitor, etc).
endmenu
```
